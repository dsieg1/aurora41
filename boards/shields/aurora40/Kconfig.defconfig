## boards/shields/aurora40/Kconfig.defconfig
```kconfig
if SHIELD_AURORA40_LEFT

config ZMK_BLE
	default y

config ZMK_USB
	default y

config ZMK_KEYBOARD_NAME
    default "Aurora40"

config ZMK_SPLIT_ROLE_CENTRAL
    default y

endif

if SHIELD_AURORA40_LEFT || SHIELD_AURORA40_RIGHT

config ZMK_SPLIT
    default y

endif
```

## boards/shields/aurora40/Kconfig.shield
```kconfig
# No whitespace after comma or in name!

config SHIELD_AURORA40_LEFT
    def_bool $(shields_list_contains,aurora40_left)

config SHIELD_AURORA40_RIGHT
    def_bool $(shields_list_contains,aurora40_right)

&bluetooth {
    compatible = "zmk,bluetooth";
    status = "okay";
};
```
